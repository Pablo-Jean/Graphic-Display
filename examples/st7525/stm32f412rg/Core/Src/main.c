/* USER CODE BEGIN Header */
/**
  ******************************************************************************
  * @file           : main.c
  * @brief          : Main program body
  ******************************************************************************
  * @attention
  *
  * Copyright (c) 2024 STMicroelectronics.
  * All rights reserved.
  *
  * This software is licensed under terms that can be found in the LICENSE file
  * in the root directory of this software component.
  * If no LICENSE file comes with this software, it is provided AS-IS.
  *
  ******************************************************************************
  */
/* USER CODE END Header */
/* Includes ------------------------------------------------------------------*/
#include "main.h"
#include "spi.h"
#include "gpio.h"

/* Private includes ----------------------------------------------------------*/
/* USER CODE BEGIN Includes */
#include <stdbool.h>
#include <stddef.h>

#include "GraphicDisplay.h"
#include "GraphicDisplay_Fonts.h"
#include "drivers/st7525/st7525.h"
/* USER CODE END Includes */

/* Private typedef -----------------------------------------------------------*/
/* USER CODE BEGIN PTD */

/* USER CODE END PTD */

/* Private define ------------------------------------------------------------*/
/* USER CODE BEGIN PD */

/* USER CODE END PD */

/* Private macro -------------------------------------------------------------*/
/* USER CODE BEGIN PM */

/* USER CODE END PM */

/* Private variables ---------------------------------------------------------*/

/* USER CODE BEGIN PV */
st7525_t St7525 = {0};
gd_t Graphic = {0};

#define cobra_width 	 64
#define cobra_height 	 64
const unsigned char cobra_bmp [] ={
		0x00,0x00,0x00,0xb4,0x00,0x00,0x00,0x00,0x00,0x00,0x00,0xef,0x03,0x00,0x00,0x00,
		0x00,0x00,0xc0,0x00,0x06,0x00,0x00,0x00,0x00,0x00,0x60,0x00,0x18,0x00,0x00,0x00,
		0x00,0x00,0x30,0x0e,0x30,0x00,0x00,0x00,0x00,0x00,0x98,0x1b,0x70,0x00,0x00,0x00,
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		0xae,0x5a,0x57,0x55,0xb5,0xea,0x5e,0x35,0xf8,0xff,0xff,0xff,0xff,0xff,0xff,0x1f};
/* USER CODE END PV */

/* Private function prototypes -----------------------------------------------*/
void SystemClock_Config(void);
/* USER CODE BEGIN PFP */

/* USER CODE END PFP */

/* Private user code ---------------------------------------------------------*/
/* USER CODE BEGIN 0 */

/* Specific MCU functions to work with ST7525 */

void _dsp_a0(uint8_t s){
	HAL_GPIO_WritePin(DSP_A0_GPIO_Port, DSP_A0_Pin, s);
}

void _dsp_cs(uint8_t s){
	HAL_GPIO_WritePin(DSP_nCS_GPIO_Port, DSP_nCS_Pin, s);
}

void _dsp_reset(uint8_t s){
	HAL_GPIO_WritePin(DSP_RST_GPIO_Port, DSP_RST_Pin, s);
}

uint8_t _dsp_write(uint8_t *data, uint32_t len){
	HAL_StatusTypeDef e;

	e = HAL_SPI_Transmit(&hspi2, data, len, 100);

	return (uint8_t)e;
}

/* USER CODE END 0 */

/**
  * @brief  The application entry point.
  * @retval int
  */
int main(void)
{

  /* USER CODE BEGIN 1 */
	st7525_params_t St7525_Params = {
			.Mode = ST7525_MODE_SPI,
			.eFrameRate = ST7525_FR_76fps,
			.bUseExternalFrameBuffer = false,
			.bInvertY = true,
			.bInvertX = false,
			.u32Heigth = 64,
			.u32Width = 192,
			.u32Offset = 0,
			.delayMs = HAL_Delay,
			.spiA0 = _dsp_a0,
			.spiCS = _dsp_cs,
			.spiReset = _dsp_reset,
			.spiWrite = _dsp_write
	};

	gd_params_t Graphic_Params = {
			.DisplayDriver = Gd_Driver_ST7525,
			.DisplayHandle = (void*)(&St7525),
			.u32Height = 64,
			.u32Width = 192
	};
  /* USER CODE END 1 */

  /* MCU Configuration--------------------------------------------------------*/

  /* Reset of all peripherals, Initializes the Flash interface and the Systick. */
  HAL_Init();

  /* USER CODE BEGIN Init */

  /* USER CODE END Init */

  /* Configure the system clock */
  SystemClock_Config();

  /* USER CODE BEGIN SysInit */

  /* USER CODE END SysInit */

  /* Initialize all configured peripherals */
  MX_GPIO_Init();
  MX_SPI2_Init();
  /* USER CODE BEGIN 2 */
	ST7525_Init(&St7525, &St7525_Params);

	GD_Init(&Graphic, &Graphic_Params);

	GD_DrawBitmap(&Graphic, 0, 0, cobra_bmp, cobra_width, cobra_height, GD_WHITE);

	GD_SetCursor(&Graphic, 105, 5);
	GD_WriteString(&Graphic, "ST7525", Font_11x18, GD_WHITE);

	GD_DrawCircle(&Graphic, 100, 30, 7, GD_WHITE);
	GD_FillCircle(&Graphic, 100, 30, 5, GD_WHITE);

	GD_DrawCircle(&Graphic, 160, 30, 7, GD_WHITE);
	GD_FillCircle(&Graphic, 160, 30, 5, GD_WHITE);

	GD_DrawRectangle(&Graphic, 78, 43, 182, 62, GD_WHITE);
	GD_FillRectangle(&Graphic, 80, 45, 180, 60, GD_WHITE);

	GD_UpdateScreen(&Graphic);

	HAL_Delay(1000);
  /* USER CODE END 2 */

  /* Infinite loop */
  /* USER CODE BEGIN WHILE */
  while (1)
  {
    /* USER CODE END WHILE */

    /* USER CODE BEGIN 3 */
  }
  /* USER CODE END 3 */
}

/**
  * @brief System Clock Configuration
  * @retval None
  */
void SystemClock_Config(void)
{
  RCC_OscInitTypeDef RCC_OscInitStruct = {0};
  RCC_ClkInitTypeDef RCC_ClkInitStruct = {0};

  /** Configure the main internal regulator output voltage
  */
  __HAL_RCC_PWR_CLK_ENABLE();
  __HAL_PWR_VOLTAGESCALING_CONFIG(PWR_REGULATOR_VOLTAGE_SCALE1);

  /** Initializes the RCC Oscillators according to the specified parameters
  * in the RCC_OscInitTypeDef structure.
  */
  RCC_OscInitStruct.OscillatorType = RCC_OSCILLATORTYPE_HSE;
  RCC_OscInitStruct.HSEState = RCC_HSE_ON;
  RCC_OscInitStruct.PLL.PLLState = RCC_PLL_ON;
  RCC_OscInitStruct.PLL.PLLSource = RCC_PLLSOURCE_HSE;
  RCC_OscInitStruct.PLL.PLLM = 12;
  RCC_OscInitStruct.PLL.PLLN = 96;
  RCC_OscInitStruct.PLL.PLLP = RCC_PLLP_DIV2;
  RCC_OscInitStruct.PLL.PLLQ = 2;
  RCC_OscInitStruct.PLL.PLLR = 2;
  if (HAL_RCC_OscConfig(&RCC_OscInitStruct) != HAL_OK)
  {
    Error_Handler();
  }

  /** Initializes the CPU, AHB and APB buses clocks
  */
  RCC_ClkInitStruct.ClockType = RCC_CLOCKTYPE_HCLK|RCC_CLOCKTYPE_SYSCLK
                              |RCC_CLOCKTYPE_PCLK1|RCC_CLOCKTYPE_PCLK2;
  RCC_ClkInitStruct.SYSCLKSource = RCC_SYSCLKSOURCE_PLLCLK;
  RCC_ClkInitStruct.AHBCLKDivider = RCC_SYSCLK_DIV1;
  RCC_ClkInitStruct.APB1CLKDivider = RCC_HCLK_DIV2;
  RCC_ClkInitStruct.APB2CLKDivider = RCC_HCLK_DIV1;

  if (HAL_RCC_ClockConfig(&RCC_ClkInitStruct, FLASH_LATENCY_3) != HAL_OK)
  {
    Error_Handler();
  }
}

/* USER CODE BEGIN 4 */

/* USER CODE END 4 */

/**
  * @brief  This function is executed in case of error occurrence.
  * @retval None
  */
void Error_Handler(void)
{
  /* USER CODE BEGIN Error_Handler_Debug */
  /* User can add his own implementation to report the HAL error return state */
  __disable_irq();
  while (1)
  {
  }
  /* USER CODE END Error_Handler_Debug */
}

#ifdef  USE_FULL_ASSERT
/**
  * @brief  Reports the name of the source file and the source line number
  *         where the assert_param error has occurred.
  * @param  file: pointer to the source file name
  * @param  line: assert_param error line source number
  * @retval None
  */
void assert_failed(uint8_t *file, uint32_t line)
{
  /* USER CODE BEGIN 6 */
  /* User can add his own implementation to report the file name and line number,
     ex: printf("Wrong parameters value: file %s on line %d\r\n", file, line) */
  /* USER CODE END 6 */
}
#endif /* USE_FULL_ASSERT */
